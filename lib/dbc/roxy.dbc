VERSION ""

NS_ :

BS_:

BU_: front_ecu central_ecu rear_ecu

BO_ 512 rear_medium: 3 rear_ecu
 SG_ speedometer : 0|10@1+ (0.1,0) [0|100] "km/h" central_ecu
 SG_ tachometer : 10|13@1+ (1,0) [0|8191] "rpm" central_ecu

BO_ 513 rear_slow: 3 rear_ecu
 SG_ obj_temp : 0|12@1+ (0.1,-40) [-40|300] "deg" central_ecu
 SG_ amb_temp : 12|12@1+ (0.1,-40) [-40|100] "deg" central_ecu

BO_ 514 rear_fast: 48 rear_ecu
 SG_ accel_x_l : 0|16@1- (0.000244140625,0) [-8|8] "g" central_ecu
 SG_ accel_y_l : 16|16@1- (0.000244140625,0) [-8|8] "g" central_ecu
 SG_ accel_z_l : 32|16@1- (0.000244140625,0) [-8|8] "g" central_ecu
 SG_ gyro_x_l : 48|16@1- (0.061,0) [-1998|1998] "dps" central_ecu
 SG_ gyro_y_l : 64|16@1- (0.061,0) [-1998|1998] "dps" central_ecu
 SG_ gyro_z_l : 80|16@1- (0.061,0) [-1998|1998] "dps" central_ecu
 SG_ accel_x_r : 96|16@1- (0.000244140625,0) [-8|8] "g" central_ecu
 SG_ accel_y_r : 112|16@1- (0.000244140625,0) [-8|8] "g" central_ecu
 SG_ accel_z_r : 128|16@1- (0.000244140625,0) [-8|8] "g" central_ecu
 SG_ gyro_x_r : 144|16@1- (0.061,0) [-1998|1998] "dps" central_ecu
 SG_ gyro_y_r : 160|16@1- (0.061,0) [-1998|1998] "dps" central_ecu
 SG_ gyro_z_r : 176|16@1- (0.061,0) [-1998|1998] "dps" central_ecu
 SG_ accel_x_c : 192|16@1- (0.000244140625,0) [-8|8] "g" central_ecu
 SG_ accel_y_c : 208|16@1- (0.000244140625,0) [-8|8] "g" central_ecu
 SG_ accel_z_c : 224|16@1- (0.000244140625,0) [-8|8] "g" central_ecu
 SG_ gyro_x_c : 240|16@1- (0.061,0) [-1998|1998] "dps" central_ecu
 SG_ gyro_y_c : 256|16@1- (0.061,0) [-1998|1998] "dps" central_ecu
 SG_ gyro_z_c : 272|16@1- (0.061,0) [-1998|1998] "dps" central_ecu

BA_DEF_ BO_  "VFrameFormat" ENUM  "StandardCAN","ExtendedCAN","reserved","J1939PG","reserved","reserved","reserved","reserved","reserved","reserved","reserved","reserved","reserved","reserved","StandardCAN_FD","ExtendedCAN_FD";
BA_DEF_  "DatabaseVersion" STRING ;
BA_DEF_  "BusType" STRING ;
BA_DEF_  "ProtocolType" STRING ;
BA_DEF_  "DatabaseCompiler" STRING ;
BA_DEF_DEF_  "VFrameFormat" "StandardCAN";
BA_DEF_DEF_  "DatabaseVersion" "";
BA_DEF_DEF_  "BusType" "";
BA_DEF_DEF_  "ProtocolType" "";
BA_DEF_DEF_  "DatabaseCompiler" "";
BA_ "BusType" "CAN FD";
BA_ "VFrameFormat" BO_ 512 14;
BA_ "VFrameFormat" BO_ 513 14;
BA_ "VFrameFormat" BO_ 514 15;
BA_ "DatabaseCompiler" "UBC BAJA";
BA_ "DatabaseVersion" "1.0.0";
