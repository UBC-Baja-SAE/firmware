VERSION ""

NS_ :

BS_:

BU_: front_ecu central_ecu rear_ecu

BO_ 512 rear_daq: 114 Vector__XXX
 SG_ speedometer : 96|6@1+ (0,0) [0|0] "" Vector__XXX
 SG_ tachometer : 112|12@1+ (0,0) [0|0] "" Vector__XXX
 SG_ accel_x : 0|16@1- (0.000244140625,0) [-8|8] "" Vector__XXX
 SG_ accel_y : 16|16@1- (0.000244140625,0) [-8|8] "" Vector__XXX
 SG_ accel_z : 32|16@1- (0.000244140625,0) [-8|8] "" Vector__XXX
 SG_ gyro_x : 48|16@1- (0.061,0) [-1998|1998] "" Vector__XXX
 SG_ gyro_y : 64|16@1- (0.061,0) [-1998|1998] "" Vector__XXX
 SG_ gyro_z : 80|16@1- (0.061,0) [-1998|1998] "" Vector__XXX
 SG_ obj_temp : 128|16@1+ (0.02,-273.15) [-70|380] "" Vector__XXX
 SG_ amb_temp : 144|16@1+ (0.02,-273.15) [-70|380] "" Vector__XXX

BO_ 17 fuck_you: 8 Vector__XXX
 SG_ microstrain : 0|32@1- (0,0) [0|0] "" Vector__XXX

BA_DEF_ BO_  "VFrameFormat" ENUM  "StandardCAN","ExtendedCAN","reserved","J1939PG";
BA_DEF_  "DatabaseVersion" STRING ;
BA_DEF_  "BusType" STRING ;
BA_DEF_  "ProtocolType" STRING ;
BA_DEF_  "DatabaseCompiler" STRING ;
BA_DEF_DEF_  "VFrameFormat" "StandardCAN";
BA_DEF_DEF_  "DatabaseVersion" "";
BA_DEF_DEF_  "BusType" "";
BA_DEF_DEF_  "ProtocolType" "";
BA_DEF_DEF_  "DatabaseCompiler" "";
BA_ "BusType" "CAN";
BA_ "DatabaseCompiler" "UBC BAJA";
BA_ "DatabaseVersion" "1.0.0";

SIG_VALTYPE_ 17 microstrain : 1;
