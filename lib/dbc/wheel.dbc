VERSION ""

NS_ :

BS_:

BU_: SteeringECU MainController

BO_ 288 SteeringStatus: 2 SteeringECU
 SG_ SteeringAngle : 0|16@1- (0.1,0) [-3600|3600] "deg"  MainController

CM_ BO_ 288 "Contains steering wheel angle.";
CM_ SG_ 288 SteeringAngle "Steering angle in degrees (0.1 deg resolution).";
