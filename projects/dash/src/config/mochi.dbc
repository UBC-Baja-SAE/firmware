VERSION ""

NS_ :

BS_:

BU_: RearECU RR_ECU RL_ECU FR_ECU FL_ECU Dash

BO_ 256 RR_IMU: 12 RR_ECU
 SG_ accelX : 0|16@1- (1,0) [-32768|32767] "" Dash
 SG_ accelY : 16|16@1- (1,0) [-32768|32767] "" Dash
 SG_ accelZ : 32|16@1- (1,0) [-32768|32767] "" Dash
 SG_ gyroX : 48|16@1- (1,0) [-32768|32767] "" Dash
 SG_ gyroY : 64|16@1- (1,0) [-32768|32767] "" Dash
 SG_ gyroZ : 80|16@1- (1,0) [-32768|32767] "" Dash

BO_ 257 RR_Suspension: 1 RR_ECU
 SG_ travel : 0|8@1+ (1,0) [0|255] "" Dash

BO_ 512 RL_IMU: 12 RL_ECU
 SG_ accelX : 0|16@1- (1,0) [-32768|32767] "" Dash
 SG_ accelY : 16|16@1- (1,0) [-32768|32767] "" Dash
 SG_ accelZ : 32|16@1- (1,0) [-32768|32767] "" Dash
 SG_ gyroX : 48|16@1- (1,0) [-32768|32767] "" Dash
 SG_ gyroY : 64|16@1- (1,0) [-32768|32767] "" Dash
 SG_ gyroZ : 80|16@1- (1,0) [-32768|32767] "" Dash

BO_ 513 RL_Suspension: 1 RL_ECU
 SG_ travel : 0|8@1+ (1,0) [0|255] "" Dash

BO_ 768 FR_IMU: 12 FR_ECU
 SG_ accelX : 0|16@1- (1,0) [-32768|32767] "" Dash
 SG_ accelY : 16|16@1- (1,0) [-32768|32767] "" Dash
 SG_ accelZ : 32|16@1- (1,0) [-32768|32767] "" Dash
 SG_ gyroX : 48|16@1- (1,0) [-32768|32767] "" Dash
 SG_ gyroY : 64|16@1- (1,0) [-32768|32767] "" Dash
 SG_ gyroZ : 80|16@1- (1,0) [-32768|32767] "" Dash

BO_ 769 FR_Suspension: 1 FR_ECU
 SG_ travel : 0|8@1+ (1,0) [0|255] "" Dash

BO_ 1024 FL_IMU: 12 FL_ECU
 SG_ accelX : 0|16@1- (1,0) [-32768|32767] "" Dash
 SG_ accelY : 16|16@1- (1,0) [-32768|32767] "" Dash
 SG_ accelZ : 32|16@1- (1,0) [-32768|32767] "" Dash
 SG_ gyroX : 48|16@1- (1,0) [-32768|32767] "" Dash
 SG_ gyroY : 64|16@1- (1,0) [-32768|32767] "" Dash
 SG_ gyroZ : 80|16@1- (1,0) [-32768|32767] "" Dash

BO_ 1025 FL_Suspension: 1 FL_ECU
 SG_ travel : 0|8@1+ (1,0) [0|255] "" Dash

BO_ 1280 RearECU_Status: 4 RearECU
 SG_ speedometer : 0|16@1+ (1,0) [0|65535] "" Dash
 SG_ tachometer : 16|16@1+ (1,0) [0|65535] "" Dash
